## dts/bindings/sensor/st,vl53l4cd.yaml
```yaml
# Copyright (c) 2023 STMicroelectronics
# SPDX-License-Identifier: Apache-2.0

description: |
  STMicroelectronics VL53L4CD Time-of-Flight ranging sensor

  The VL53L4CD is a Time-of-Flight (ToF) ranging sensor providing
  accurate distance measurements up to 130cm.

compatible: "st,vl53l4cd"

include: [sensor-device.yaml, i2c-device.yaml]

properties:
  reg:
    required: true

  xshut-gpios:
    type: phandle-array
    description: |
      XSHUT (shutdown) pin. This pin can be used to shutdown
      the sensor or perform hardware reset.

      This pin is active low, meaning:
      - Low = sensor shutdown
      - High = sensor active
```

## sensor/vl53l4cd/KConfig
```kconfig
# ST VL53L4CD Time-of-Flight ranging sensor configuration

config VL53L4CD
	bool "VL53L4CD Time-of-Flight distance sensor"
	default y
	select SENSOR
	help
	  Enable driver for VL53L4CD Time-of-Flight distance sensor.

if VL53L4CD

config VL53L4CD_XSHUT_GPIO
	bool "Enable XSHUT GPIO control"
	depends on GPIO
	help
	  Enable XSHUT (shutdown) GPIO control for hardware reset functionality.
	  This allows the driver to perform hardware reset of the sensor.

config VL53L4CD_I2C_FAST_MODE_PLUS
	bool "Enable I2C Fast Mode Plus (1MHz)"
	help
	  Enable I2C Fast Mode Plus operation up to 1MHz.
	  Default operation is up to 400kHz.

endif # VL53L4CD
```

## sensor/vl53l4cd/Kconfig
```kconfig
# ST VL53L4CD Time-of-Flight ranging sensor configuration

config VL53L4CD
	bool "VL53L4CD Time-of-Flight distance sensor"
	default n
	select SENSOR
	help
	  Enable driver for VL53L4CD Time-of-Flight distance sensor.

if VL53L4CD

config VL53L4CD_XSHUT_GPIO
    bool "Enable XSHUT GPIO control"
    default y
    help
      Enable XSHUT GPIO control for power management and reset.

config VL53L4CD_INT_GPIO
    bool "Enable interrupt GPIO support"
    default n
    help
      Enable interrupt GPIO support for data ready notifications.
      When enabled, the sensor can generate interrupts when new
      ranging data is available.


config VL53L4CD_I2C_FAST_MODE_PLUS
	bool "Enable I2C Fast Mode Plus (1MHz)"
	help
	  Enable I2C Fast Mode Plus operation up to 1MHz.
	  Default operation is up to 400kHz.

endif # VL53L4CD
```
